VERSION "synthetic teaching"
NS_ :

BS_:
BU_: Teaching
BO_ 288 Pack: 3 Teaching
 SG_ PackVoltage : 0|16@1+ (0.1,0) [0|6553.5] "V" Teaching
 SG_ ChargeState : 16|8@1+ (1,0) [0|255] "1" Teaching
VAL_ 288 ChargeState 0 "idle" 1 "charging";
BA_DEF_ BO_ "GenMsgCycleTime" INT 0 2147483647;
BA_ "GenMsgCycleTime" BO_ 288 100;
