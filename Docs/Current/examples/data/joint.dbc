VERSION "synthetic-home"
NS_ :

BS_:
BU_: Node
BO_ 256 Frame: 2 Node
 SG_ Voltage : 0|8@1+ (2,1) [0|511] "V" Node
 SG_ Mode : 8|8@1+ (1,0) [0|255] "" Node
