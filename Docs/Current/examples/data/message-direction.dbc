VERSION "synthetic-home"
NS_ :

BS_:
BU_: Node
BO_ 256 Power: 3 Node
 SG_ Power : 0|16@1+ (1,0) [0|65535] "W" Node
 SG_ Direction : 16|8@1- (1,0) [-128|127] "1" Node
