VERSION "synthetic teaching"
NS_ :

BS_:
BU_: Teaching
BO_ 256 Power: 2 Teaching
 SG_ Power : 0|16@1+ (1,0) [0|65535] "W" Teaching
BO_ 257 Voltage: 2 Teaching
 SG_ Voltage : 0|16@1+ (1,0) [0|65535] "V" Teaching
BA_DEF_ BO_ "GenMsgCycleTime" INT 0 2147483647;
BA_ "GenMsgCycleTime" BO_ 256 1000;
BA_ "GenMsgCycleTime" BO_ 257 500;
