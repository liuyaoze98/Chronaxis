VERSION "synthetic-home"
NS_ :

BS_:
BU_: Node
BO_ 256 Power: 2 Node
 SG_ Power : 0|16@1+ (1,0) [0|65535] "W" Node
