VERSION "Chronaxis current example"
NS_ :

BS_:
BU_: Meter
BO_ 256 Amps: 1 Meter
 SG_ Current : 0|8@1+ (1,0) [0|255] "A" Meter
BA_DEF_ BO_ "GenMsgCycleTime" INT 0 65535;
BA_DEF_DEF_ "GenMsgCycleTime" 0;
BA_ "GenMsgCycleTime" BO_ 256 100;
